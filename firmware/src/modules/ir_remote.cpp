// IR transmitter. The IRremote library keeps its implementation in .hpp files and defines global objects, so
// this is the only translation unit that includes it.
//
// Settings chosen before the include:
//  - no receiver code: nothing here listens, so no timer interrupt is ever installed;
//  - no LED feedback code: the library must not drive any other pin;
//  - the send pin is given at run time (IrSender.setSendPin): the library attaches it to LEDC channel 0 at the start
//    of a frame, and this file detaches it again afterwards (and tells the library, see park()).
// The carrier (36/38/40 kHz) is generated by the LEDC peripheral; the bit timing is a busy wait in the caller's
// task (the worker), so a frame blocks it for its duration.
#define DISABLE_CODE_FOR_RECEIVER
#define NO_LED_FEEDBACK_CODE

#include "ir_remote.h"

#include <Arduino.h>
#include <IRremote.hpp>

namespace oyster::ir {
namespace {

#if defined(ESP_ARDUINO_VERSION_MAJOR) && ESP_ARDUINO_VERSION_MAJOR >= 3
#error "ir_remote.cpp is written for Arduino-ESP32 2.x (ledcAttachPin API); port park() before upgrading"
#endif

// Leaves the LED off and the pin free of the LEDC peripheral. The LED is driven low, which is the idle level
// of the library's own PWM output. The library remembers which pin it attached; forgetting it makes the next
// frame attach the pin again.
void park() {
  ledcDetachPin(kTxPin);
  pinMode(kTxPin, OUTPUT);
  digitalWrite(kTxPin, LOW);
  sLastSendPin = 0;
}

bool valid(const ircodes::Frame& f) {
  using ircodes::Protocol;
  if (f.repeats > 3) return false;
  switch (f.protocol) {
    case Protocol::Nec:
    case Protocol::Samsung32:
      return f.address <= 0xFF && f.command <= 0xFF;
    case Protocol::Sirc12:
      return f.address <= 0x1F && f.command <= 0x7F && f.bits == 12;
    case Protocol::Rc5:
      return f.address <= 0x1F && f.command <= 0x3F;
  }
  return false;
}

}  // namespace

bool send(const ircodes::Frame& f) {
  using ircodes::Protocol;
  if (!valid(f)) return false;
  IrSender.setSendPin(kTxPin);
  switch (f.protocol) {
    case Protocol::Nec:
      IrSender.sendNEC(f.address, f.command, f.repeats);
      break;
    case Protocol::Samsung32:
      IrSender.sendSamsung(f.address, f.command, f.repeats);
      break;
    case Protocol::Sirc12:
      IrSender.sendSony(f.address, static_cast<uint8_t>(f.command), f.repeats, 12);
      break;
    case Protocol::Rc5:
      IrSender.sendRC5(static_cast<uint8_t>(f.address), static_cast<uint8_t>(f.command), f.repeats);
      break;
  }
  park();
  return true;
}

}  // namespace oyster::ir
